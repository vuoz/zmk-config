## boards/shields/corne_dongle/Kconfig.shield
```kconfig
# No whitespace after the comma or in the keyboard name!
config SHIELD_CORNE_DONGLE
    def_bool $(shields_list_contains,corne_dongle)
```

## boards/shields/splitkb_aurora_corne/Kconfig.shield
```kconfig
# No whitespace after the comma or in the keyboard name!
config SHIELD_SPLITKB_AURORA_CORNE_DONGLE
    def_bool $(shields_list_contains,splitkb_aurora_corne_dongle)
```
